## drivers/video/android/Kconfig
```kconfig
config ANDROID_FRAMEBUFFER
	bool "Android framebuffer driver"
	depends on FB
	default n
	---help---
	  Say Y here if you want to build the Android framebuffer driver.
```
